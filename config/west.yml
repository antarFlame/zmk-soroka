## config/west.yml
```yaml
manifest:
  remotes:
    - name: zmkfirmware
      url-base: https://github.com/zmkfirmware
    - name: sqdbruh
      url-base: https://github.com/sqdbruh
  projects:
    - name: zmk
      remote: sqdbruh
      revision: 87cea76c93fd959d94a16632f6f70209140681ac
      import: app/west.yml
  self:
    path: config
```
